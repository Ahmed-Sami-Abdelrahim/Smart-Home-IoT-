## meta-smart-home/build/conf/bblayers.conf
```bitbake
POKY_BBLAYERS_CONF_VERSION = "2"

BBPATH = "${TOPDIR}"
BBFILES ?= ""

BBLAYERS ?= " \
  /home/ahmedsami/poky/meta \
  /home/ahmedsami/poky/meta-poky \
  /home/ahmedsami/poky/meta-yocto-bsp \
  /home/ahmedsami/poky/meta-custom \
  /home/ahmedsami/poky/meta-openembedded/meta-oe \
  /home/ahmedsami/poky/meta-openembedded/meta-webserver \
  /home/ahmedsami/poky/meta-raspberrypi \
  "
```

## meta-smart-home/build/conf/local.conf
```bitbake
#
# Local Configuration File for Smart Home Project
# This file contains settings specific to building a smart home system.
#

# Machine Selection
# Target machine configuration.
MACHINE = "raspberrypi3"

# Kernel Settings
PREFERRED_PROVIDER_virtual/kernel = "linux-raspberrypi"

# Parallel Build Settings
BB_NUMBER_THREADS = "16"
PARALLEL_MAKE = "-j 16"

# Directories for Build Artifacts
# Define paths for downloads, shared-state, and temporary files.
DL_DIR ?= "${TOPDIR}/downloads"
SSTATE_DIR ?= "${TOPDIR}/sstate-cache"
TMPDIR = "${TOPDIR}/tmp"

# Enable removal of work directories to save disk space
RM_WORK = "1"

# Distribution Settings
DISTRO ?= "poky"

# Package Management Configuration
PACKAGE_CLASSES ?= "package_rpm"

# Disk Space Monitoring
# Ensure adequate disk space to prevent build failures.
BB_DISKMON_DIRS ??= "\
    STOPTASKS,${TMPDIR},2G,100K \
    STOPTASKS,${DL_DIR},2G,100K \
    STOPTASKS,${SSTATE_DIR},2G,100K \
    STOPTASKS,/tmp,500M,100K \
    HALT,${TMPDIR},500M,1K \
    HALT,${DL_DIR},500M,1K \
    HALT,${SSTATE_DIR},500M,1K \
    HALT,/tmp,50M,1K"


# Configuration Version
CONF_VERSION = "2"
```
